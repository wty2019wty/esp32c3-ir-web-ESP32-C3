## main/Kconfig.projbuild
```kconfig
menu "IR Web Tool Configuration"

    config IR_TOOL_IR_RX_GPIO
        int "IR receiver GPIO (VS1838B OUT)"
        default 4
        help
            VS1838B demodulated baseband output, idle high.

    config IR_TOOL_IR_TX_GPIO
        int "IR transmitter GPIO (needs transistor driver)"
        default 3
        help
            Carrier-modulated output. Drive an IR LED via a transistor.

    config IR_TOOL_CARRIER_FREQ_HZ
        int "Default IR carrier frequency (Hz)"
        default 38000
        help
            Carrier frequency used for IR transmission. Can be changed at
            runtime from the web UI (persisted in NVS). Common values:
            38000 (most consumer electronics), 36000, 40000.

    config IR_TOOL_CARRIER_DUTY
        int "IR carrier duty cycle (percent)"
        default 33
        help
            Duty cycle of the carrier signal in percent. 25-50%, 33% is common.

    config IR_TOOL_WIFI_AP_SSID
        string "SoftAP SSID"
        default "ESP32C3-IR"

    config IR_TOOL_WIFI_AP_PASSWORD
        string "SoftAP password (empty = open network)"
        default ""

    config IR_TOOL_WIFI_AP_CHANNEL
        int "SoftAP channel"
        default 1

    config IR_TOOL_WIFI_AP_MAX_CONN
        int "SoftAP max connections"
        default 4

    config IR_TOOL_WIFI_STA_SSID
        string "Station SSID (empty = skip station)"
        default ""

    config IR_TOOL_WIFI_STA_PASSWORD
        string "Station password"
        default ""

    config IR_TOOL_WIFI_STA_TIMEOUT_MS
        int "Station connection timeout (ms), then fall back to SoftAP"
        default 10000

    config IR_TOOL_WIFI_STA_TX_POWER_DBM
        int "Max station TX power (dBm)"
        default 15
        range 8 20
        help
            Cap the station TX power. Some ESP32-C3 boards fail open-auth
            (WIFI_REASON_AUTH_EXPIRE, reason 2) at the default 20 dBm while
            SoftAP works fine; 15 dBm connects reliably on such boards.

    config IR_TOOL_HTTP_PORT
        int "HTTP server port"
        default 80

    config IR_TOOL_HOSTNAME
        string "DHCP hostname (shown in router client list)"
        default "ir-web"

    config IR_TOOL_HISTORY_DEPTH
        int "In-memory frame history depth"
        default 8
        help
            In-memory history ring. Each slot holds one full frame including
            the raw duration array (IR_TOOL_MAX_RX_SEGS entries, 4 bytes each),
            so RAM usage = depth x frame size. With 1024 segments one frame is
            about 4.2 KB; the default 8 slots keep static RAM around 34 KB.

    config IR_TOOL_MAX_RX_SEGS
        int "Max alternating IR segments per captured frame"
        default 1024
        range 192 2048
        help
            Number of alternating on/off duration segments a single IR frame
            can hold (air-conditioner protocols often exceed 300 segments).
            The RMT RX ping-pong mode accumulates long frames in a RAM buffer,
            so the limit is memory, not the 192-symbol RMT hardware. Each
            segment costs 4 bytes inside every history frame slot.

    config IR_TOOL_MAX_RAW_SYMBOLS
        int "Max RMT symbols per transmission (raw data replay)"
        default 2048

    menu "MQTT Client"

        config IR_TOOL_MQTT_ENABLE
            bool "Enable MQTT client"
            default y
            help
                Enable the built-in MQTT client. The broker URI below still has
                to be set for the client to connect; an empty URI disables MQTT
                at runtime even with this option enabled. All values can also
                be changed from the Web settings page (persisted in NVS and
                taking priority over these defaults).

        config IR_TOOL_MQTT_BROKER_URI
            string "Broker URI (empty = MQTT disabled)"
            default ""
            help
                For example mqtt://192.168.1.100:1883 or
                mqtts://broker.example.com:8883.

        config IR_TOOL_MQTT_USERNAME
            string "MQTT username (empty = anonymous)"
            default ""

        config IR_TOOL_MQTT_PASSWORD
            string "MQTT password (empty = no password)"
            default ""

        config IR_TOOL_MQTT_CLIENT_ID
            string "MQTT client ID (empty = auto from MAC address)"
            default ""

        config IR_TOOL_MQTT_TOPIC_CMD
            string "Command topic (subscribe)"
            default "ir-web/cmd"

        config IR_TOOL_MQTT_TOPIC_RSP
            string "Command response topic (publish)"
            default "ir-web/rsp"

        config IR_TOOL_MQTT_TOPIC_STATUS
            string "Status topic (publish, also used for LWT)"
            default "ir-web/status"

        config IR_TOOL_MQTT_TOPIC_FRAME
            string "IR frame topic (publish)"
            default "ir-web/frame"

        config IR_TOOL_MQTT_QOS
            int "MQTT QoS for subscribe/publish"
            default 1
            range 0 2
            help
                QoS 0 = at most once, QoS 1 = at least once (default),
                QoS 2 = exactly once. Frames are best-effort; use QoS 1 so the
                outbox retransmits anything the broker did not acknowledge.

        config IR_TOOL_MQTT_PUBLISH_FRAMES
            bool "Publish captured IR frames"
            default y
            help
                Publish every newly captured frame (same JSON shape as the
                WebSocket frame push) to the frame topic.

        config IR_TOOL_MQTT_PUBLISH_STATUS
            bool "Publish status on connect / play state changes"
            default y
            help
                Publish the full status object to the status topic when the
                client connects and whenever playback starts/stops.

    endmenu

endmenu
```
